/dts-v1/;
/plugin/;

#include <dt-bindings/gpio/gpio.h>

/ {
	fragment@0 {
		target = <&gpio2>;
		__overlay__ {
			status = "okay";
			sodimm_141 {
				gpio-hog;
				gpios = <7 GPIO_ACTIVE_HIGH>;
				output-low;
				line-name = "sodimm_141";
			};
		};
	};
};
